/***********************************************************************/
/*  FILE        :lcd.c                                                 */
/*  DATE        :Mar, 2014                                             */
/*  Programmer	:xiang 'R                                              */
/*  CPU TYPE    :STM8L151G6     Crystal: 16M HSI                       */
/*  DESCRIPTION :                                                      */
/*  Mark        :ver 1.0                                               */
/***********************************************************************/

#include <iostm8l151g4.h> // CPU型号
#include "Pin_define.h"   // 管脚定义
#include "ram.h"          // RAM定义
#include "lcd.h"          // RAM定义
#include "ADF7030_1.h"

/******************************************************************************
 * FunctionName: lcd_init
 *
 * Function Description: This function initializes display controller.
 *
 * Function Parameter: None
 *
 * Function Returns: void
 *
*********************************************************************************/
void lcd_init(void)
{
    PIN_LCD_SEL = 0;
    ;                //Selected LCD
    PIN_LCD_RST = 0; //Reset
    delay(100);
    PIN_LCD_RST = 1;
    ; //Reset OK
    delay(20);
    send_command(0xe2); //LCD soft Reset
    delay(5);
    send_command(0x2c); //Booster ratio set1
    delay(5);
    send_command(0x2e); //Booster ratio set2
    delay(5);
    send_command(0x2f); //Booster ratio set3
    delay(5);
    send_command(0x24); //Coarse contrast
    send_command(0x81); //Contrast trimming
    send_command(0x1a); //Contrast trimming ,Value
    send_command(0xa2); //1/9 LCD bias set)
    send_command(0xc8); //Common output mode select
    send_command(0xa0); //Column scanning*/
    send_command(0x40); //The initial line of display settings
    send_command(0xaf); //display ON
    Display_key_SW3 = 0xff;
    FlagLCDUpdate.BYTE = 0x00;
    LCDFirstDisplayFlag = 1;
    lcd_clear(1);
    //    lcd_desplay();
    PIN_LCD_SEL = 1; // not Selected LCD
}

/******************************************************************************
 * FunctionName: send_command
 *
 * Function Description: This function is send command.
 *
 * Function Parameter:
 * data   :   command.
 *
 * Function Returns: void
 *
*********************************************************************************/
void send_command(UINT8 data)
{
    UINT8 i;
    PIN_LCD_SEL = 0;   //Selected LCD
    PIN_LCD_A0_RS = 0; //command
    for (i = 0; i < 8; i++)
    {
        PIN_LCD_SCLK = 0;
        if (data & 0x80)
            PIN_LCD_SDATA = 1;
        else
            PIN_LCD_SDATA = 0;
        PIN_LCD_SCLK = 1;
        data = data << 1;
    }
}
/******************************************************************************
 * FunctionName: send_data
 *
 * Function Description: This function is display data.
 *
 * Function Parameter:
 * data   :   display data.
 *
 * Function Returns: void
 *
*********************************************************************************/
void send_data(UINT8 data)
{
    UINT8 i;
    PIN_LCD_SEL = 0; //Selected LCD
    PIN_LCD_A0_RS = 1;
    ; //data
    for (i = 0; i < 8; i++)
    {
        PIN_LCD_SCLK = 0;
        if (data & 0x80)
            PIN_LCD_SDATA = 1;
        else
            PIN_LCD_SDATA = 0;
        PIN_LCD_SCLK = 1;
        data = data << 1;
    }
}

/******************************************************************************
 * FunctionName: delay
 *
 * Function Description: This function is delay.
 *
 * Function Parameter:
 * i   :  delay NUM.
 *
 * Function Returns: void
 *
*********************************************************************************/
void delay(UINT16 i)
{
    UINT16 j, k;
    for (j = 0; j < i; j++)
        for (k = 0; k < 110; k++)
            ;
}

/*************************************************/
//LCD显示(L)*(H 8的倍数)，串行模式
//说明：x,y代表坐标；L和H代表图像大小
/*************************************************/
void display_map_xy(unsigned char x, unsigned char y, unsigned char l, unsigned char h, const unsigned char *p)
{
    unsigned char i;
    unsigned char seg;
    unsigned char page;
    unsigned char com0, com1;
    com1 = x / 16 + 0x10;
    com0 = x % 16;
    for (i = 0; i < h / 8; i++)
    {
        page = 0xb0 + i + y / 8;
        send_command(page);
        send_command(com1); //列地址，高低字节两次写入，从第0 列开始
        send_command(com0);
        for (seg = x; seg < (l + x); seg++) //写128 列
        {
            send_data(*p++);
        }
    }
}
/**
 ****************************************************************************
 * @Function : void display_map_58_6(u8 x,u8 y,u8 l,u8 h,const u8 *p)
 * @File     : lcd.c
 * @Program  :
 * @Created  : 2017/5/4 by Xiaowine
 * @Brief    :
 * @Version  : V1.0
**/
void display_map_58_6(unsigned char x, unsigned char y, unsigned char len, const unsigned char *p)
{
    unsigned char i;
    for (i = 0; i < len; i++) //test mode
        display_map_xy(x + i * 6, y, 5, 8, char_Small + (*p++ - ' ') * 5);
}

void lcd_clear(unsigned char data1)
{
    //------ò???ê????á3ìDò
    unsigned char seg;
    unsigned char page;
    for (page = 0xb0; page < 0xb9; page++) //D′ò3μ??·128 ò3 0xb0----0xb8
    {
        send_command(page);
        send_command(0x10); //áDμ??·￡???μí×??úá?′?D′è?￡?′óμú0 áD?aê?
        send_command(0x00);
        for (seg = 0; seg < 128; seg++) //D′128 áD
        {
            if (data1 == 1)
                send_data(0x00);
            else
                send_data(0xFF);
        }
    }
}

void lcd_clear_1and2_line(unsigned char data1)
{
    //------ò???ê????á3ìDò
    unsigned char seg;
    unsigned char page;
    for (page = 0xb0; page < 0xb2; page++) //D′ò3μ??·128 ò3 0xb0----0xb8
    {
        send_command(page);
        send_command(0x10); //áDμ??·￡???μí×??úá?′?D′è?￡?′óμú0 áD?aê?
        send_command(0x00);
        for (seg = 0; seg < 128; seg++) //D′128 áD
        {
            if (data1 == 1)
                send_data(0x00);
            else
                send_data(0xFF);
        }
    }
}

void lcd_clear_3and8_line(unsigned char data1)
{
    //------ò???ê????á3ìDò
    unsigned char seg;
    unsigned char page;
    for (page = 0xb2; page < 0xb9; page++) //D′ò3μ??·128 ò3 0xb0----0xb8
    {
        send_command(page);
        send_command(0x10); //áDμ??·￡???μí×??úá?′?D′è?￡?′óμú0 áD?aê?
        send_command(0x00);
        for (seg = 0; seg < 128; seg++) //D′128 áD
        {
            if (data1 == 1)
                send_data(0x00);
            else
                send_data(0xFF);
        }
    }
}
/**
 ****************************************************************************
 * @Function : void LCDTestDisplay(void)
 * @File     : lcd.c
 * @Program  :
 * @Created  : 2017/4/19 by Xiaowine
 * @Brief    :
 * @Version  : V1.0
**/
void LCDTestDisplay(void)
{
    char TestWords[] = {"TEST MODEFilter GFSKPAx PA 1dBmTESTppm"};
    u8 i = 0, j, k;
    if (Display_key_SW3 != Count_key_SW3)
    {
        Display_key_SW3 = Count_key_SW3;
        lcd_clear(1);
        display_map_xy(1, 9, 5, 8, char_Small + ('*' - ' ') * 5);
        k = i;
        j = k + 9;
        for (i = i; i < j; i++) //test mode
            display_map_xy(27 + 6 * (i - k), 0, 5, 8, char_Small + (TestWords[i] - ' ') * 5);
        k = i;
        j = k + 11;
        for (i = i; i < j; i++) //fsk
            display_map_xy(10 + 6 * (i - k), 9, 5, 8, char_Small + (TestWords[i] - ' ') * 5);
        k = i;
        j = k + 8;
        for (i = i; i < j; i++) //paX
            display_map_xy(10 + 6 * (i - k), 18, 5, 8, char_Small + (TestWords[i] - ' ') * 5);
        k = i;
        j = k + 3;
        for (i = i; i < j; i++) //dBm
            display_map_xy(10 + 6 * (i - k), 27, 5, 8, char_Small + (TestWords[i] - ' ') * 5);
        display_map_xy(52, 27, 5, 8, char_Small + ('0' - ' ') * 5);
        k = i;
        j = k + 4;
        for (i = i; i < j; i++) //TEST
            display_map_xy(10 + 6 * (i - k), 36, 5, 8, char_Small + (TestWords[i] - ' ') * 5);
        k = i;
        j = k + 3;
        for (i = i; i < j; i++) //ppm
            display_map_xy(10 + 6 * (i - k), 45, 5, 8, char_Small + (TestWords[i] - ' ') * 5);
    }
    if (LCDUpdateIDFlag == 1)
    {
        LCDUpdateIDFlag = 0;
        switch (DATA_Packet_Contro_buf)
        {
        case 0x14:
            break; //stop+login
        case 0x40:
            break; //自动送信
        case 0x01:
            break; //VENT
        case 0x02:
            display_map_58_6(50, 63, 5, "CLOSE");
            break;
        case 0x04:
            display_map_58_6(50, 63, 5, "STOP ");
            break;
        case 0x08:
            display_map_58_6(50, 63, 5, "OPEN ");
            break;
        case 0x0C:
            break; //open+stop
        case 0x06:
            break; //close+stop
        case 0x0A:
            break; //close+OPEN
        case 0x09:
            break; //vent+OPEN
        case 0x03:
            break; //vent+close
        default:
            break;
        }
    }
}

/************************************************************/
void lcd_desplay(void)
{
    UINT8 i, data;
    UINT32 num;

    if (Display_key_SW3 != Count_key_SW3)
    {
        Display_key_SW3 = Count_key_SW3;
        lcd_clear(1);

        if (Display_key_SW3 == 0)
        {
            Head_0x5515_or_0x5456 = 0x5515;
            display_map_xy(40 + 0 * 25, 0, 24, 24, char_company + 0 * 72);
            display_map_xy(40 + 1 * 25, 0, 24, 24, char_company + 1 * 72);
        }
        else
        {
            Head_0x5515_or_0x5456 = 0x5456;
            display_map_xy(40 + 0 * 25, 0, 24, 24, char_company + 2 * 72);
            display_map_xy(40 + 1 * 25, 0, 24, 24, char_company + 3 * 72);
        }
        //*************************DISPLAY  "ID_CHECKER"
        display_map_xy(4, 32, 12, 24, char_ID_CHECKER);
        display_map_xy(4 + 1 * 12, 32, 12, 24, char_ID_CHECKER + 1 * 36);
        display_map_xy(4 + 3 * 12, 32, 12, 24, char_ID_CHECKER + 3 * 36);
        display_map_xy(4 + 4 * 12, 32, 12, 24, char_ID_CHECKER + 4 * 36);
        display_map_xy(4 + 5 * 12, 32, 12, 24, char_ID_CHECKER + 5 * 36);
        display_map_xy(4 + 6 * 12, 32, 12, 24, char_ID_CHECKER + 6 * 36);
        display_map_xy(4 + 7 * 12, 32, 12, 24, char_ID_CHECKER + 7 * 36);
        display_map_xy(4 + 8 * 12, 32, 12, 24, char_ID_CHECKER + 8 * 36);
        display_map_xy(4 + 9 * 12, 32, 12, 24, char_ID_CHECKER + 9 * 36);
    }
    if (LCDUpdateIDFlag == 1)
    {
        LCDUpdateIDFlag = 0;
        if (LCDFirstDisplayFlag == 1)
        {
            LCDFirstDisplayFlag = 0;
            lcd_clear(1);
        }
        num = DATA_Packet_ID;
        for (i = 0; i < 8; i++)
        {
            data = num % 10;
            num = num / 10;
            //display_map_xy(12+(7-i)*13,32,11,24,char_Large_L11_H24+data*33);
            display_map_xy(1 + (7 - i) * 9, 24, 7, 16, char_Medium + data * 14);
        }

        switch (DATA_Packet_Contro_buf)
        {
        case 0x14: //stop+login
            break;
        case 0x40: //自动送信
            break;
        case 0x01: //VENT
            break;
        case 0x02: //close
                   //                    display_map_xy(1,48,8,16,char_Contro+8*16);
                   //                    display_map_xy(1+1*9,48,8,16,char_Contro+9*16);
                   //                    display_map_xy(1+2*9,48,8,16,char_Contro+10*16);
                   //                    display_map_xy(1+3*9,48,8,16,char_Contro+11*16);
                   //                    display_map_xy(1+4*9,48,8,16,char_Contro+12*16);

            display_map_xy(0, 40, 2, 24, char_Contro + 13 * 48);
            display_map_xy(2, 40, 16, 24, char_Contro + 8 * 48);
            display_map_xy(2 + 1 * 16, 40, 16, 24, char_Contro + 9 * 48);
            display_map_xy(2 + 2 * 15, 40, 16, 24, char_Contro + 10 * 48);
            display_map_xy(2 + 3 * 16, 40, 16, 24, char_Contro + 11 * 48);
            display_map_xy(2 + 4 * 16, 40, 16, 24, char_Contro + 12 * 48);
            break;
        case 0x04: //stop
                   //                                display_map_xy(1,48,8,16,char_Contro+4*16);
                   //                                display_map_xy(1+1*9,48,8,16,char_Contro+5*16);
                   //                                display_map_xy(1+2*9,48,8,16,char_Contro+6*16);
                   //                                display_map_xy(1+3*9,48,8,16,char_Contro+7*16);
                   //                                display_map_xy(1+4*9,48,8,16,char_Contro+13*16);  //空

            display_map_xy(0, 40, 2, 24, char_Contro + 13 * 48);
            display_map_xy(2, 40, 16, 24, char_Contro + 4 * 48);
            display_map_xy(2 + 1 * 16, 40, 16, 24, char_Contro + 5 * 48);
            display_map_xy(2 + 2 * 15, 40, 16, 24, char_Contro + 6 * 48);
            display_map_xy(2 + 3 * 16, 40, 16, 24, char_Contro + 7 * 48);
            display_map_xy(2 + 4 * 16, 40, 16, 24, char_Contro + 13 * 48);
            break;
        case 0x08: //open
                   //                                display_map_xy(1,48,8,16,char_Contro+0*16);
                   //                                display_map_xy(1+1*9,48,8,16,char_Contro+1*16);
                   //                                display_map_xy(1+2*9,48,8,16,char_Contro+2*16);
                   //                                display_map_xy(1+3*9,48,8,16,char_Contro+3*16);
                   //                                display_map_xy(1+4*9,48,8,16,char_Contro+13*16);   //空

            display_map_xy(0, 40, 16, 24, char_Contro + 0 * 48);
            display_map_xy(2 + 1 * 16, 40, 16, 24, char_Contro + 1 * 48);
            display_map_xy(2 + 2 * 16, 40, 16, 24, char_Contro + 2 * 48);
            display_map_xy(2 + 3 * 16, 40, 16, 24, char_Contro + 3 * 48);
            display_map_xy(2 + 4 * 16, 40, 16, 24, char_Contro + 13 * 48);
            break;
        case 0x0C: //open+stop
            break;
        case 0x06: //close+stop
            break;
        case 0x0A: //close+OPEN
            break;
        case 0x09: //vent+OPEN
            break;
        case 0x03: //vent+close
            break;
        default:
            break;
        }
    }
}

//***************************DisplayRSSI********************************************************
void LCD_display_argos_rssi(unsigned int m)
{
    /*  unsigned char i,x;
  if(m>1300)m=1300;
  if(lcd_rssi!=m){
    for(i=4;i>=1;i--){
      x=m%10;
      m=m/10;
      if(i==1){
        if(x==0){
          display_map_xy(86,0,5,8,char_Small);
          display_map_xy(86+i*6,0,5,8,char_Small+0x0d*5);
        }
        else {
          display_map_xy(86,0,5,8,char_Small+0x0d*5);
          display_map_xy(86+i*6,0,5,8,char_Small+(0x10+x)*5);
        }
      }
      else if(i==4){if(x>=6)m=m+1;}
      else  display_map_xy(86+i*6,0,5,8,char_Small+(0x10+x)*5);
    }

    display_map_xy(86+24,0,5,8,char_Small+0x44*5);      //显示dBm
    display_map_xy(86+24+1*6,0,5,8,char_Small+0x22*5);
    display_map_xy(86+24+2*6,0,5,8,char_Small+0x4d*5);
    lcd_rssi=m;
  }*/
}
/**
****************************************************************************
* @Function : void LCDDisplayRISS(void)
* @File     : lcd.c
* @Program  :
* @Created  : 2017/4/18 by Xiaowine
* @Brief    : 绘制信号强度
* @Version  : V1.0
**/
void LCDDisplayRISS(void)
{
    if (LCDUpdateRISSFlag != 0)
    {
        //      if(Flag_Display_key_SW3==1){Flag_Display_key_SW3=0;lcd_clear(1);}
        //lcd_clear_1and2_line(1);
        //LCD_display_argos_rssi((130-RAM_rssi_AVG)*10);
        LCDRSSI = 130 - RAM_RSSI_AVG;
        if (LCDRSSI > 110)
        {
            //RSSI_level=0;
            display_map_xy(1 + 0 * 20, 0, 16, 16, char_RSSI + 0 * 32);
            display_map_xy(1 + 1 * 20, 0, 16, 16, char_RSSI + 0 * 32);
            display_map_xy(1 + 2 * 20, 0, 16, 16, char_RSSI + 0 * 32);
            display_map_xy(1 + 3 * 20, 0, 16, 16, char_RSSI + 0 * 32);
        }
        else if (LCDRSSI > 100)
        {
            //RSSI_level=1;
            display_map_xy(1 + 0 * 20, 0, 16, 16, char_RSSI + 1 * 32);
            display_map_xy(1 + 1 * 20, 0, 16, 16, char_RSSI + 0 * 32);
            display_map_xy(1 + 2 * 20, 0, 16, 16, char_RSSI + 0 * 32);
            display_map_xy(1 + 3 * 20, 0, 16, 16, char_RSSI + 0 * 32);
        }
        else if (LCDRSSI > 80)
        {
            //RSSI_level=2;
            display_map_xy(1 + 0 * 20, 0, 16, 16, char_RSSI + 1 * 32);
            display_map_xy(1 + 1 * 20, 0, 16, 16, char_RSSI + 1 * 32);
            display_map_xy(1 + 2 * 20, 0, 16, 16, char_RSSI + 0 * 32);
            display_map_xy(1 + 3 * 20, 0, 16, 16, char_RSSI + 0 * 32);
        }
        else if (LCDRSSI > 60)
        {
            //RSSI_level=3;
            display_map_xy(1 + 0 * 20, 0, 16, 16, char_RSSI + 1 * 32);
            display_map_xy(1 + 1 * 20, 0, 16, 16, char_RSSI + 1 * 32);
            display_map_xy(1 + 2 * 20, 0, 16, 16, char_RSSI + 1 * 32);
            display_map_xy(1 + 3 * 20, 0, 16, 16, char_RSSI + 0 * 32);
        }
        else
        {
            //RSSI_level=4;
            display_map_xy(1 + 0 * 20, 0, 16, 16, char_RSSI + 1 * 32);
            display_map_xy(1 + 1 * 20, 0, 16, 16, char_RSSI + 1 * 32);
            display_map_xy(1 + 2 * 20, 0, 16, 16, char_RSSI + 1 * 32);
            display_map_xy(1 + 3 * 20, 0, 16, 16, char_RSSI + 1 * 32);
        }
    }
}

const unsigned char char_Large_L11_H24[] = {
    /*--  宽度x高度=11x24  --*/
    // ASCII码(HEX)  字符
    0xE0, 0xF8, 0xFC, 0x3E, 0x0E, 0x0E, 0x0E, 0xBE, 0xFC, 0xF8, 0xE0, 0xFF, 0xFF, 0xFF, 0xC0, 0xF0, //30       0
    0x7C, 0x1E, 0x07, 0xFF, 0xFF, 0xFF, 0x0F, 0x3F, 0x7F, 0xFB, 0xE0, 0xE0, 0xE0, 0xF8, 0x7F, 0x3F,
    0x0F,
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    0x00, 0x00, 0x00, 0x00, 0x00, 0x00, 0x00, 0x00, 0x00, 0x00, 0x00, 0x00, 0x00, 0x00, 0x00, 0x00,
    0x00};

const unsigned char char_ID[] = { //ID CHECKER
    /*--  宽度x高度=110x24  --*/
    0x00, 0x00, 0x20, 0x20, 0x20, 0xE0, 0x20, 0x20, 0x20, 0x00, 0x00, 0x20, 0xE0, 0x20, 0x20, 0x20,
    0x20, 0x60, 0x40, 0x80, 0x00, 0x00, 0x00, 0x00, 0x00, 0x00, 0x00, 0x00, 0x00, 0x00, 0x00, 0x00,
    0x00, 0x00, 0x00, 0x80, 0x40, 0x20, 0x20, 0x20, 0x20, 0x60, 0xE0, 0x00, 0x20, 0xE0, 0x20, 0x00,
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    0x1F, 0x10, 0x00, 0x00, 0x00, 0x00, 0x03, 0x0C, 0x10, 0x10};

const unsigned char char_ID_CHECKER[] = { //ID CHECKER
    /*--  文字:  I  --*/
    /*--  宋体18;  此字体下对应的点阵为：宽x高=12x24   --*/
    0x00, 0x20, 0x20, 0x20, 0xE0, 0xE0, 0xE0, 0xE0, 0x20, 0x20, 0x20, 0x00, 0x00, 0x00, 0x00, 0x00,
    0xFF, 0xFF, 0xFF, 0xFF, 0x00, 0x00, 0x00, 0x00, 0x00, 0x10, 0x10, 0x10, 0x1F, 0x1F, 0x1F, 0x1F,
    0x10, 0x10, 0x10, 0x00,

    /*--  文字:  D  --*/
    /*--  宋体18;  此字体下对应的点阵为：宽x高=12x24   --*/
    0x20, 0xE0, 0xE0, 0xE0, 0x20, 0x20, 0x60, 0xE0, 0xC0, 0xC0, 0x80, 0x00, 0x00, 0xFF, 0xFF, 0xFF,
    0x00, 0x00, 0x00, 0x00, 0x03, 0xFF, 0xFF, 0x00, 0x10, 0x1F, 0x1F, 0x1F, 0x10, 0x10, 0x18, 0x1C,
    0x0F, 0x0F, 0x07, 0x00,

    /*--  文字:  :  --*/
    /*--  宋体18;  此字体下对应的点阵为：宽x高=12x24   --*/
    0x00, 0x00, 0x00, 0x00, 0x00, 0x00, 0x00, 0x00, 0x00, 0x00, 0x00, 0x00, 0x00, 0x00, 0x00, 0x00,
    0x0E, 0x0E, 0x0E, 0x0E, 0x00, 0x00, 0x00, 0x00, 0x00, 0x00, 0x00, 0x00, 0x1C, 0x1C, 0x1C, 0x1C,
    0x00, 0x00, 0x00, 0x00,

    /*--  文字:  C  --*/
    /*--  宋体18;  此字体下对应的点阵为：宽x高=12x24   --*/
    0x00, 0x80, 0xC0, 0xC0, 0xE0, 0x60, 0x20, 0x20, 0x60, 0xE0, 0xE0, 0x00, 0xFC, 0xFF, 0xFF, 0x03,
    0x00, 0x00, 0x00, 0x00, 0x00, 0x00, 0x01, 0x00, 0x01, 0x07, 0x0F, 0x1F, 0x18, 0x10, 0x10, 0x10,
    0x18, 0x0E, 0x07, 0x00,

    /*--  文字:  H  --*/
    /*--  宋体18;  此字体下对应的点阵为：宽x高=12x24   --*/
    0x20, 0xE0, 0xE0, 0xE0, 0x20, 0x00, 0x00, 0x20, 0xE0, 0xE0, 0xE0, 0x00, 0x00, 0xFF, 0xFF, 0xFF,
    0x10, 0x10, 0x10, 0x10, 0xFF, 0xFF, 0xFF, 0x00, 0x10, 0x1F, 0x1F, 0x1F, 0x10, 0x00, 0x00, 0x10,
    0x1F, 0x1F, 0x1F, 0x00,

    /*--  文字:  E  --*/
    /*--  宋体18;  此字体下对应的点阵为：宽x高=12x24   --*/
    0x20, 0xE0, 0xE0, 0xE0, 0x20, 0x20, 0x20, 0x20, 0x60, 0xE0, 0xE0, 0x00, 0x00, 0xFF, 0xFF, 0xFF,
    0x10, 0x10, 0x10, 0x7C, 0x7C, 0x00, 0x00, 0x00, 0x10, 0x1F, 0x1F, 0x1F, 0x10, 0x10, 0x10, 0x10,
    0x18, 0x1C, 0x1E, 0x00,

    /*--  文字:  C  --*/
    /*--  宋体18;  此字体下对应的点阵为：宽x高=12x24   --*/
    0x00, 0x80, 0xC0, 0xC0, 0xE0, 0x60, 0x20, 0x20, 0x60, 0xE0, 0xE0, 0x00, 0xFC, 0xFF, 0xFF, 0x03,
    0x00, 0x00, 0x00, 0x00, 0x00, 0x00, 0x01, 0x00, 0x01, 0x07, 0x0F, 0x1F, 0x18, 0x10, 0x10, 0x10,
    0x18, 0x0E, 0x07, 0x00,

    /*--  文字:  K  --*/
    /*--  宋体18;  此字体下对应的点阵为：宽x高=12x24   --*/
    0x20, 0xE0, 0xE0, 0xE0, 0x20, 0x20, 0x20, 0xE0, 0xE0, 0x60, 0x20, 0x00, 0x00, 0xFF, 0xFF, 0xFF,
    0x38, 0x7E, 0xFF, 0xE3, 0x81, 0x00, 0x00, 0x00, 0x10, 0x1F, 0x1F, 0x1F, 0x10, 0x10, 0x01, 0x17,
    0x1F, 0x1E, 0x18, 0x00,

    /*--  文字:  E  --*/
    /*--  宋体18;  此字体下对应的点阵为：宽x高=12x24   --*/
    0x20, 0xE0, 0xE0, 0xE0, 0x20, 0x20, 0x20, 0x20, 0x60, 0xE0, 0xE0, 0x00, 0x00, 0xFF, 0xFF, 0xFF,
    0x10, 0x10, 0x10, 0x7C, 0x7C, 0x00, 0x00, 0x00, 0x10, 0x1F, 0x1F, 0x1F, 0x10, 0x10, 0x10, 0x10,
    0x18, 0x1C, 0x1E, 0x00,

    /*--  文字:  R  --*/
    /*--  宋体18;  此字体下对应的点阵为：宽x高=12x24   --*/
    0x20, 0xE0, 0xE0, 0xE0, 0x20, 0x20, 0x20, 0x60, 0xE0, 0xE0, 0xC0, 0x00, 0x00, 0xFF, 0xFF, 0xFF,
    0x10, 0x30, 0xF0, 0xF8, 0xDF, 0x0F, 0x07, 0x00, 0x10, 0x1F, 0x1F, 0x1F, 0x10, 0x10, 0x00, 0x07,
    0x1F, 0x1F, 0x18, 0x10

};

const unsigned char char_company[] = { //公司
    /*--  文字:  文  --*/
    /*--  宋体18;  此字体下对应的点阵为：宽x高=24x24   --*/
    0x00, 0x40, 0x40, 0x40, 0x40, 0x40, 0x40, 0xC0, 0xC0, 0x40, 0x4C, 0x7C, 0x78, 0x50, 0x40, 0xC0,
    0xC0, 0xC0, 0x40, 0x60, 0x60, 0xE0, 0xC0, 0x00, 0x00, 0x00, 0x00, 0x00, 0x00, 0x00, 0x00, 0x07,
    0x3F, 0xFC, 0xF0, 0xC0, 0xC0, 0xF8, 0xFF, 0x3F, 0x07, 0x00, 0x00, 0x00, 0x00, 0x00, 0x00, 0x00,
    0x00, 0x40, 0x40, 0x40, 0x60, 0x60, 0x30, 0x10, 0x18, 0x0C, 0x0F, 0x07, 0x07, 0x0F, 0x1C, 0x18,
    0x38, 0x30, 0x30, 0x70, 0x60, 0x20, 0x20, 0x00,

    /*--  文字:  化  --*/
    /*--  宋体18;  此字体下对应的点阵为：宽x高=24x24   --*/
    0x00, 0x00, 0x00, 0x00, 0xC0, 0xF0, 0xFC, 0x3C, 0x0C, 0x0C, 0x00, 0x00, 0xFC, 0xFC, 0xFC, 0x04,
    0x00, 0x80, 0xC0, 0xC0, 0xC0, 0x80, 0x00, 0x00, 0x40, 0x70, 0x38, 0x1E, 0xFF, 0xFF, 0xFF, 0x03,
    0x00, 0x80, 0xC0, 0xC0, 0xFF, 0xFF, 0xFF, 0x1C, 0x0E, 0x07, 0x03, 0x01, 0x00, 0x00, 0x00, 0x00,
    0x00, 0x00, 0x00, 0x00, 0x7F, 0x7F, 0x7F, 0x02, 0x03, 0x01, 0x01, 0x00, 0x1F, 0x3F, 0x3F, 0x20,
    0x20, 0x20, 0x20, 0x20, 0x3F, 0x3F, 0x38, 0x00,

    /*--  文字:  新  --*/
    /*--  宋体18;  此字体下对应的点阵为：宽x高=24x24   --*/
    0x00, 0x20, 0x20, 0x60, 0xE0, 0xE4, 0xBC, 0x3C, 0xF8, 0xE0, 0xF0, 0x70, 0x30, 0xF8, 0xF8, 0xF0,
    0x10, 0x18, 0x18, 0x0C, 0x0C, 0x1C, 0x18, 0x00, 0x00, 0x44, 0x44, 0xC4, 0xC5, 0x47, 0xFF, 0xFE,
    0xFF, 0x45, 0x64, 0x26, 0x66, 0xFF, 0xFF, 0xFF, 0x04, 0x04, 0xFC, 0xFC, 0x06, 0x06, 0x06, 0x00,
    0x20, 0x30, 0x3C, 0x2F, 0x27, 0x23, 0x7F, 0x7F, 0x3F, 0x43, 0x6F, 0x7E, 0x3C, 0x1F, 0x07, 0x01,
    0x00, 0x00, 0x7F, 0x7F, 0x00, 0x00, 0x00, 0x00,

    /*--  文字:  生  --*/
    /*--  宋体18;  此字体下对应的点阵为：宽x高=24x24   --*/
    0x00, 0x00, 0x00, 0x00, 0xE0, 0xF8, 0xF8, 0x38, 0x10, 0x00, 0x00, 0xFE, 0xFC, 0xFC, 0x00, 0x00,
    0x00, 0x80, 0xC0, 0xC0, 0xC0, 0x00, 0x00, 0x00, 0x00, 0x30, 0x38, 0x1F, 0x47, 0x43, 0x41, 0x41,
    0x41, 0x41, 0x41, 0xFF, 0xFF, 0xFF, 0x41, 0x41, 0x41, 0x61, 0x61, 0x60, 0x41, 0x01, 0x00, 0x00,
    0x00, 0x20, 0x20, 0x20, 0x20, 0x20, 0x20, 0x20, 0x20, 0x20, 0x20, 0x3F, 0x3F, 0x3F, 0x20, 0x20,
    0x20, 0x20, 0x20, 0x20, 0x30, 0x30, 0x20, 0x00

};

//&&&&&&&&&&&&&&&&&&&&&&&&&&&&&&&&&&&&&&&&//
//以下是字库
//&&&&&&&&&&&&&&&&&&&&&&&&&&&&&&&&&&&&&&&&//
const unsigned char char_Small[] = {
    /*--  宽度x高度=5x8  --*/
    // ASCII码(HEX)  字符
    0x00, 0x00, 0x00, 0x00, 0x00, //20      空白
    0x00, 0x00, 0xBE, 0x00, 0x00, //21       ！
    0x00, 0x00, 0x00, 0x00, 0x00, //22       “       空
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    0x28, 0x10, 0x7C, 0x10, 0x28  //82        *
};

const unsigned char char_Medium[] = {
    /*--  宽度x高度=7x16  --*/
    // ASCII码(HEX)  字符
    0xF8, 0xFC, 0x06, 0x86, 0xC6, 0xFC, 0xF8, 0x3F, 0x7F, 0xC7, 0xC3, 0xC1, 0x7F, 0x3F, //30         0
    0x00, 0x18, 0x1C, 0xFE, 0xFE, 0x00, 0x00, 0x00, 0xC0, 0xC0, 0xFF, 0xFF, 0xC0, 0xC0, //31         1
    0x1C, 0x1E, 0x0E, 0x06, 0x86, 0xFE, 0xFC, 0xF8, 0xFC, 0xCE, 0xC7, 0xC3, 0xC1, 0xC0, //32         2
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    0x0C, 0x18, 0x70, 0xFE, 0xFE, 0x70, 0x1C, 0xC3, 0x63, 0x1B, 0xFF, 0xFF, 0x3B, 0x63  //43        *
};

const unsigned char char_Contro[] = {
    ///*--  文字:  O  --*/
    ///*--  宋体12;  此字体下对应的点阵为：宽x高=8x16   --*/
    //0xE0,0x10,0x08,0x08,0x08,0x10,0xE0,0x00,0x0F,0x10,0x20,0x20,0x20,0x10,0x0F,0x00,
    //
    ///*--  文字:  P  --*/
    ///*--  宋体12;  此字体下对应的点阵为：宽x高=8x16   --*/
    //0x08,0xF8,0x08,0x08,0x08,0x08,0xF0,0x00,0x20,0x3F,0x21,0x01,0x01,0x01,0x00,0x00,
    //
    ///*--  文字:  E  --*/
    ///*--  宋体12;  此字体下对应的点阵为：宽x高=8x16   --*/
    //0x08,0xF8,0x88,0x88,0xE8,0x08,0x10,0x00,0x20,0x3F,0x20,0x20,0x23,0x20,0x18,0x00,
    //
    ///*--  文字:  N  --*/
    ///*--  宋体12;  此字体下对应的点阵为：宽x高=8x16   --*/
    //0x08,0xF8,0x30,0xC0,0x00,0x08,0xF8,0x08,0x20,0x3F,0x20,0x00,0x07,0x18,0x3F,0x00,
    //
    ///*--  文字:  S  --*/
    ///*--  宋体12;  此字体下对应的点阵为：宽x高=8x16   --*/
    //0x00,0x70,0x88,0x08,0x08,0x08,0x38,0x00,0x00,0x38,0x20,0x21,0x21,0x22,0x1C,0x00,
    //
    ///*--  文字:  T  --*/
    ///*--  宋体12;  此字体下对应的点阵为：宽x高=8x16   --*/
    //0x18,0x08,0x08,0xF8,0x08,0x08,0x18,0x00,0x00,0x00,0x20,0x3F,0x20,0x00,0x00,0x00,
    //
    ///*--  文字:  O  --*/
    ///*--  宋体12;  此字体下对应的点阵为：宽x高=8x16   --*/
    //0xE0,0x10,0x08,0x08,0x08,0x10,0xE0,0x00,0x0F,0x10,0x20,0x20,0x20,0x10,0x0F,0x00,
    //
    ///*--  文字:  P  --*/
    ///*--  宋体12;  此字体下对应的点阵为：宽x高=8x16   --*/
    //0x08,0xF8,0x08,0x08,0x08,0x08,0xF0,0x00,0x20,0x3F,0x21,0x01,0x01,0x01,0x00,0x00,
    //
    ///*--  文字:  C  --*/
    ///*--  宋体12;  此字体下对应的点阵为：宽x高=8x16   --*/
    //0xC0,0x30,0x08,0x08,0x08,0x08,0x38,0x00,0x07,0x18,0x20,0x20,0x20,0x10,0x08,0x00,
    //
    ///*--  文字:  L  --*/
    ///*--  宋体12;  此字体下对应的点阵为：宽x高=8x16   --*/
    //0x08,0xF8,0x08,0x00,0x00,0x00,0x00,0x00,0x20,0x3F,0x20,0x20,0x20,0x20,0x30,0x00,
    //
    ///*--  文字:  O  --*/
    ///*--  宋体12;  此字体下对应的点阵为：宽x高=8x16   --*/
    //0xE0,0x10,0x08,0x08,0x08,0x10,0xE0,0x00,0x0F,0x10,0x20,0x20,0x20,0x10,0x0F,0x00,
    //
    ///*--  文字:  S  --*/
    ///*--  宋体12;  此字体下对应的点阵为：宽x高=8x16   --*/
    //0x00,0x70,0x88,0x08,0x08,0x08,0x38,0x00,0x00,0x38,0x20,0x21,0x21,0x22,0x1C,0x00,
    //
    ///*--  文字:  E  --*/
    ///*--  宋体12;  此字体下对应的点阵为：宽x高=8x16   --*/
    //0x08,0xF8,0x88,0x88,0xE8,0x08,0x10,0x00,0x20,0x3F,0x20,0x20,0x23,0x20,0x18,0x00,
    //
    ///*--  文字:  空  --*/
    //0x00,0x00,0x00,0x00,0x00,0x00,0x00,0x00,0x00,0x00,0x00,0x00,0x00,0x00,0x00,0x00

    //// O(0) P(1) E(2)
    //// N(3) S(4) T(5)
    //// O(6) P(7) C(8)
    //// L(9) O(10) S(11)
    //// E(12)
    //
    //0xC0,0xE0,0x30,0x10,0x10,0x10,0x30,0xE0,0x03,0x07,0x0C,0x08,0x08,0x08,0x0C,0x07,/*"O",0*/
    //
    //0xF0,0xF0,0x10,0x10,0x10,0xF0,0xE0,0x00,0x0F,0x0F,0x01,0x01,0x01,0x00,0x00,0x00,/*"P",1*/
    //
    //0xF0,0xF0,0x90,0x90,0x90,0x10,0x00,0x00,0x0F,0x0F,0x08,0x08,0x08,0x08,0x00,0x00,/*"E",2*/
    //
    //0xF0,0xF0,0x70,0xC0,0x80,0x00,0xF0,0xF0,0x0F,0x0F,0x00,0x01,0x03,0x06,0x0F,0x0F,/*"N",3*/
    //
    //0x60,0xF0,0x90,0x90,0x90,0x10,0x00,0x00,0x08,0x08,0x08,0x09,0x09,0x0F,0x07,0x00,/*"S",4*/
    //
    //0x10,0x10,0xF0,0xF0,0x10,0x10,0x10,0x00,0x00,0x00,0x0F,0x0F,0x00,0x00,0x00,0x00,/*"T",5*/
    //
    //0xC0,0xE0,0x30,0x10,0x10,0x10,0x30,0xE0,0x03,0x07,0x0C,0x08,0x08,0x08,0x0C,0x07,/*"O",6*/
    //
    //0xF0,0xF0,0x10,0x10,0x10,0xF0,0xE0,0x00,0x0F,0x0F,0x01,0x01,0x01,0x00,0x00,0x00,/*"P",7*/
    //
    //0xC0,0xE0,0x20,0x10,0x10,0x10,0x10,0x00,0x03,0x07,0x0C,0x08,0x08,0x08,0x08,0x00,/*"C",8*/
    //
    //0xF0,0xF0,0x00,0x00,0x00,0x00,0x00,0x00,0x0F,0x0F,0x08,0x08,0x08,0x08,0x00,0x00,/*"L",9*/
    //
    //0xC0,0xE0,0x30,0x10,0x10,0x10,0x30,0xE0,0x03,0x07,0x0C,0x08,0x08,0x08,0x0C,0x07,/*"O",10*/
    //
    //0x60,0xF0,0x90,0x90,0x90,0x10,0x00,0x00,0x08,0x08,0x08,0x09,0x09,0x0F,0x07,0x00,/*"S",11*/
    //
    //0xF0,0xF0,0x90,0x90,0x90,0x10,0x00,0x00,0x0F,0x0F,0x08,0x08,0x08,0x08,0x00,0x00,/*"E",12*/
    ///*--  文字:  空  --*/
    //0x00,0x00,0x00,0x00,0x00,0x00,0x00,0x00,0x00,0x00,0x00,0x00,0x00,0x00,0x00,0x00

    // O(0) P(1) E(2)
    // N(3) S(4) T(5)
    // O(6) P(7) C(8)
    // L(9) O(10) S(11)
    // E(12)

    0x00, 0x00, 0x00, 0x80, 0x80, 0xC0, 0xC0, 0xC0, 0xC0, 0xC0, 0xC0, 0x80, 0x80, 0x00, 0x00, 0x00,
    0x7C, 0xFE, 0xFF, 0x83, 0x01, 0x01, 0x00, 0x00, 0x00, 0x00, 0x01, 0x01, 0x83, 0xFF, 0xFF, 0x7C,
    0x00, 0x01, 0x01, 0x03, 0x03, 0x07, 0x06, 0x06, 0x06, 0x06, 0x07, 0x03, 0x03, 0x01, 0x00, 0x00, /*"O",0*/
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    0x00, 0x07, 0x07, 0x07, 0x06, 0x06, 0x06, 0x06, 0x06, 0x06, 0x06, 0x06, 0x00, 0x00, 0x00, 0x00, /*"E",12*/

    /*--  文字:  空  --*/
    0x00, 0x00, 0x00, 0x00, 0x00, 0x00, 0x00, 0x00, 0x00, 0x00, 0x00, 0x00, 0x00, 0x00, 0x00, 0x00,
    0x00, 0x00, 0x00, 0x00, 0x00, 0x00, 0x00, 0x00, 0x00, 0x00, 0x00, 0x00, 0x00, 0x00, 0x00, 0x00,
    0x00, 0x00, 0x00, 0x00, 0x00, 0x00, 0x00, 0x00, 0x00, 0x00, 0x00, 0x00, 0x00, 0x00, 0x00, 0x00};

const unsigned char char_RSSI[] = {
    /*--  调入了一幅图像：D:\My Documents\工作资料\日本文化\文化改型\TCXO版 LCD图像数据\NULL.bmp  --*/
    /*--  宽度x高度=16x16  --*/
    0xE0, 0xF8, 0x1C, 0x0E, 0x06, 0x03, 0x03, 0x01, 0x01, 0x03, 0x03, 0x06, 0x0E, 0x1C, 0xF8, 0xE0,
    0x07, 0x1F, 0x38, 0x70, 0x60, 0xC0, 0xC0, 0x80, 0x80, 0xC0, 0xC0, 0x60, 0x70, 0x38, 0x1F, 0x07,
    /*--  调入了一幅图像：D:\My Documents\工作资料\日本文化\文化改型\TCXO版 LCD图像数据\o.bmp  --*/
    /*--  宽度x高度=16x16  --*/
    0xE0, 0xF8, 0xFC, 0xFE, 0xFE, 0xFF, 0xFF, 0xFF, 0xFF, 0xFF, 0xFF, 0xFE, 0xFE, 0xFC, 0xF8, 0xE0,
    0x07, 0x1F, 0x3F, 0x7F, 0x7F, 0xFF, 0xFF, 0xFF, 0xFF, 0xFF, 0xFF, 0x7F, 0x7F, 0x3F, 0x1F, 0x07};
